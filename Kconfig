## Kconfig
```kconfig
config MPR121_MODULE01
	bool "ZMK MPR121 Disc Module 01"
	default y
	select GPIO
	select I2C
	select KSCAN
	help
	  MPR121 capacitive Disc input processor and listener for ZMK.
	  Provides direct button scanning plus Disc gesture, proximity,
	  cursor/scroll control, tap, swipe, and rotary behaviors.
```

## dts/bindings/behaviors/zmk,behavior-disc-mode-toggle.yaml
```yaml
description: Disc cursor/scroll mode toggle behavior
compatible: "zmk,behavior-disc-mode-toggle"
include: base.yaml

properties:
  label:
    type: string
    required: true
```

## dts/bindings/input/zmk,virtual-input.yaml
```yaml
description: Virtual input device for cursor/scroll reporting
compatible: "zmk,virtual-input"

include: base.yaml
```

## dts/bindings/kscan/zmk,kscan-mpr121-disc.yaml
```yaml
description: MPR121 capacitive Disc kscan/input processor/listener
compatible: "zmk,kscan-mpr121-disc"
include: i2c-device.yaml

properties:
  irq-gpios:
    type: phandle-array
    required: true
    description: MPR121 IRQ GPIO.

  touch-threshold:
    type: int
    default: 12
    description: MPR121 electrode touch threshold.

  prox-threshold:
    type: int
    default: 6
    description: MPR121 electrode proximity/release threshold.

  center-dead-radius-mm:
    type: int
    default: 3
    description: Center no-movement zone radius in mm.

  swipe-threshold-mm:
    type: int
    default: 6
    description: Swipe detection threshold in mm.

  swipe-duration-max-ms:
    type: int
    default: 500
    description: Maximum duration for swipe detection in ms.

  tap-duration-max-ms:
    type: int
    default: 250
    description: Maximum duration for tap detection in ms.

  tap-move-max-mm:
    type: int
    default: 3
    description: Maximum movement for tap detection in mm.

  rotary-threshold-deg:
    type: int
    default: 25
    description: Rotary angle threshold in degrees.

  idle-timeout-ms:
    type: int
    default: 30000
    description: No-proximity timeout before low sample rate and idle behavior.

  velocity-slow-distance-mm:
    type: int
    default: 3
    description: Distance from center where slow acceleration section ends (mm).

  velocity-slow-value:
    type: int
    default: 2
    description: Cursor velocity at the end of slow section.

  velocity-max-distance-mm:
    type: int
    default: 12
    description: Maximum distance from center (edge of disc) in mm.

  velocity-max-value:
    type: int
    default: 16
    description: Maximum cursor velocity at the edge of the disc.

  velocity-decay-percent:
    type: int
    default: 85
    description: Velocity decay percentage when finger is stationary.
```
